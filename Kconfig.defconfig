## Kconfig.defconfig
```kconfig
if SHIELD_TOEPAD_LEFT

config ZMK_KEYBOARD_NAME
    default "Toepad"

config ZMK_SPLIT_ROLE_CENTRAL
    default y

endif

if SHIELD_TOEPAD_LEFT || SHIELD_TOEPAD_RIGHT

config ZMK_SPLIT
    default y

endif
```

## Kconfig.shield
```kconfig
config SHIELD_TOEPAD_LEFT
    def_bool $(shields_list_contains,toepad_left)

config SHIELD_TOEPAD_RIGHT
    def_bool $(shields_list_contains,toepad_right)
```
